# file: 002_REGISTER_LED_BLINK.ioc
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Mcu.Family=STM32F4
Mcu.Name=STM32F407V(E-G)Tx
Mcu.Package=LQFP100
NVIC.PriorityGroup=NVIC_PRIORITYGROUP_4
ProjectManager.HeapSize=0x200
ProjectManager.StackSize=0x400
ProjectManager.TargetToolchain=STM32CubeIDE
RCC.AHBFreq_Value=16000000
RCC.APB1Freq_Value=16000000
RCC.APB2Freq_Value=16000000
RCC.CortexFreq_Value=16000000
RCC.HSE_VALUE=25000000
RCC.HSI_VALUE=16000000
RCC.LSE_VALUE=32768
RCC.SYSCLKFreq_VALUE=16000000
RCC.VCOOutputFreq_Value=192000000
board=custom

// file: Core/Src/main.c
/* USER CODE BEGIN Header */
/**
  ******************************************************************************
  * @file           : main.c
  * @brief          : Main program body
  ******************************************************************************
  * @attention
  *
  * Copyright (c) 2024 STMicroelectronics.
  * All rights reserved.
  *
  * This software is licensed under terms that can be found in the LICENSE file
  * in the root directory of this software component.
  * If no LICENSE file comes with this software, it is provided AS-IS.
  *
  ******************************************************************************
  */
/* USER CODE END Header */
#include "main.h"

void SystemClock_Config(void);

/* USER CODE BEGIN 0 */

// All needed configuration for registers
void Configurations(void);

// RCC| Register configurations
void RCC_Config(void);

//  GPIOD Configurations + Enables GPIOD
void GPIO_Config(void);

// Turns on Lights :)
void TurnonLights(void);

// Turns off Lights :(
void TurnoffLights(void);

/* USER CODE END 0 */

int main(void)
{

  /* MCU Configuration--------------------------------------------------------*/

  /* Reset of all peripherals, Initializes the Flash interface and the Systick. */

  /* Configure the system clock */

  /* Initialize all configured peripherals */
  /* USER CODE BEGIN 2 */
	Configurations();
	int counter=0;
  /* USER CODE END 2 */

  /* Infinite loop */
  /* USER CODE BEGIN WHILE */
  while (1)
  {
	  for(counter =0;counter<268000;counter++);
	  TurnonLights();

	  for(counter=0; counter<268000;counter++);
	  TurnoffLights();
    /* USER CODE END WHILE */

  }
}

void SystemClock_Config(void)
{
  RCC_OscInitTypeDef RCC_OscInitStruct = {0};
  RCC_ClkInitTypeDef RCC_ClkInitStruct = {0};

  /** Configure the main internal regulator output voltage
  */
  __HAL_RCC_PWR_CLK_ENABLE();
  __HAL_PWR_VOLTAGESCALING_CONFIG(PWR_REGULATOR_VOLTAGE_SCALE1);

  /** Initializes the RCC Oscillators according to the specified parameters
  * in the RCC_OscInitTypeDef structure.
  */
  RCC_OscInitStruct.OscillatorType = RCC_OSCILLATORTYPE_HSI;
  RCC_OscInitStruct.HSIState = RCC_HSI_ON;
  RCC_OscInitStruct.HSICalibrationValue = RCC_HSICALIBRATION_DEFAULT;
  RCC_OscInitStruct.PLL.PLLState = RCC_PLL_NONE;
  if (HAL_RCC_OscConfig(&RCC_OscInitStruct) != HAL_OK)
  {
    Error_Handler();
  }

  /** Initializes the CPU, AHB and APB buses clocks
  */
  RCC_ClkInitStruct.ClockType = RCC_CLOCKTYPE_HCLK|RCC_CLOCKTYPE_SYSCLK
                              |RCC_CLOCKTYPE_PCLK1|RCC_CLOCKTYPE_PCLK2;
  RCC_ClkInitStruct.SYSCLKSource = RCC_SYSCLKSOURCE_HSI;
  RCC_ClkInitStruct.AHBCLKDivider = RCC_SYSCLK_DIV1;
  RCC_ClkInitStruct.APB1CLKDivider = RCC_HCLK_DIV1;
  RCC_ClkInitStruct.APB2CLKDivider = RCC_HCLK_DIV1;

  if (HAL_RCC_ClockConfig(&RCC_ClkInitStruct, FLASH_LATENCY_0) != HAL_OK)
  {
    Error_Handler();
  }
}

/* USER CODE BEGIN 4 */

void Configurations(void)
{
	RCC_Config();
	SystemCoreClockUpdate();
	GPIO_Config();
}

void RCC_Config(void)
{
	RCC->CR =  0x00000083; // RCC Reset
	RCC->CR &= ~(1<<0); // HSI OFF

	RCC->CR |= 1<<16;  // HSE ON
	while(!(RCC->CR & (1<<17))); // Wait HSE active

	RCC->CR |= 1 << 19; // CSS enabled

	RCC->PLLCFGR = 0x24003010 ; // PLLCFGR Reset
	RCC->PLLCFGR |= (1<<22); // PLL SOURCE HSE
	RCC->PLLCFGR |= (8<<0); // PLL M = 4
	RCC->PLLCFGR |= (168<<6); // PLL N = 168
	RCC->PLLCFGR &= ~(1<<16); 	RCC->PLLCFGR &= ~(1<<17); // PLL P = 2
	RCC->CR |= 1<<24; //PLL ON

	while(!(RCC->CR & (1<<25))); // Wait For PLL ON

	RCC->CFGR = 0x00000000; // Reset
	RCC->CFGR &= ~(1<<0); RCC->CFGR |= (1<<1); // PLL Selected as system clock

	while(!(RCC->CFGR& (1<<1)));
}

void GPIO_Config(void)
{

	RCC->AHB1ENR =0x00100000;
	RCC->AHB1ENR |= 1<<3; // GPIOD Clock enable

	GPIOD->MODER |= 1<<24;	 GPIOD->MODER &= ~(1<<25); 	  // 01  12nd pin output mode

	GPIOD->MODER |= 1<<26;  GPIOD->MODER &= ~(1<<27); 	// 01  13rd pin output  mode

	GPIOD->MODER |= 1<<28;  GPIOD->MODER &= ~(1<<29); // 01  14th pin output  mode

	GPIOD->MODER |= 1<<30;	GPIOD->MODER &= ~(1<<31); 	 // 01  15rd pin output  mode

	//GPIOD->OTYPER

	GPIOD->OSPEEDR |= 0xFF000000;
	//GPIOD->OSPEEDR |= FF<<24; // same
}

void TurnoffLights(void)
{
	GPIOD->ODR |= 1<<12;
	GPIOD->ODR |= 1<<13;
	GPIOD->ODR |= 1<<14;
	GPIOD->ODR |= 1<<15;
}

void TurnonLights(void)
{
	GPIOD->ODR &= ~(1<<12);
	GPIOD->ODR &= ~(1<<13);
	GPIOD->ODR &= ~(1<<14);
	GPIOD->ODR &= ~(1<<15);
}
/* USER CODE END 4 */

void Error_Handler(void)
{
  __disable_irq();
  while (1)
  {
  }
}
